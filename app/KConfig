## app/KConfig
```kconfig
menuconfig LED_Subsystem
    bool "LED Subsystem"
    default y

if LED_Subsystem        

choice
    prompt "LED blink speed time"
    default BLINK_SLEEP_TIME_1000MS

config BLINK_SLEEP_TIME_250MS
    bool "250ms (fast)"
config BLINK_SLEEP_TIME_1000MS
    bool "1s (medium)"
config BLINK_SLEEP_TIME_2000MS
    bool "2s (slow)"

endchoice 

config BLINK_SLEEP_TIME_MS
    int
    default 250 if BLINK_SLEEP_TIME_250MS
    default 1000 if BLINK_SLEEP_TIME_1000MS
    default 2000 if BLINK_SLEEP_TIME_2000MS
    default 0

menuconfig ADVANCED_LED_SETTINGS
    bool "Advanced LED settings"
    default n

if ADVANCED_LED_SETTINGS

config LED_Brightness
    int "LED Brightness"
    range 0 100
    default 100

config LED_Fade
    int "Fade duration (ms)"
    range 0 5000
    default 500

menu "Expert settings"

config LED_DEBUG
    bool "Enable LED Debugging"

config LED_CUSTOM_PATTERN
    bool "Custom blink pattern"

endmenu # Expert Settings
endif # ADVANCED_LED_SETTINGS
endif # LED_Subsystem

source "Kconfig.zephyr"
```
